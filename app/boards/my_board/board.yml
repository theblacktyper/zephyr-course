## app/boards/my_board/board.yml
```yaml
board:
  name: my_board
  full_name: MY-BOARD
  vendor: theblacktyper
  socs:
  - name: mcxn947
    variants:
    - name: qspi
      cpucluster: 'cpu0'
```

## app/boards/my_custom_board/Kconfig.my_custom_board
```kconfig
config BOARD_MY_CUSTOM_BOARD
	select SOC_MCXN947_CPU0 if BOARD_MY_CUSTOM_BOARD
	select SOC_PART_NUMBER_MCXN947VDF
```

## boards/my_custom_board/board.yml
```yaml
board:
  name: my_custom_board
  full_name: My Custom Board From Scratch
  vendor: theblacktyper
  socs:
  - name: mcxn947
    variants:
    - name: qspi
      cpucluster: 'cpu0'
```

## modules/my-driver-module/drivers/my_driver/Kconfig
```kconfig
menuconfig MY_DRIVER
    bool "My Custom Driver"
    default y
    depends on DT_HAS_MY_DRIVER_ENABLED # Only if HW is present in the DT
    depends on SENSOR
    select GPIO # Auto-pulls dependencies
    help
        sensor_sample_fetch sets led on, sensor_channel_get sets led off.
```

## modules/my-driver-module/dts/bindings/driver/my,driver.yaml
```yaml
description: My custom sensor driver binding
compatible: "my,driver"
include: sensor-device.yaml

properties:
  led:
    type: phandle
    required: true
    description: Board LED node to use (e.g. a child of a gpio-leds node)
```
