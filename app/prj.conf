## CMakeLists.txt
```
cmake_minimum_required(VERSION 3.20.0)

set(CMAKE_EXPORT_COMPILE_COMMANDS ON)

set(BOARD_FLASH_RUNNER jlink)
set(BOARD_DEBUG_RUNNER jlink)

list(APPEND BOARD_ROOT ${CMAKE_CURRENT_SOURCE_DIR}/..)
list(APPEND ZEPHYR_EXTRA_MODULES ${CMAKE_CURRENT_SOURCE_DIR}/../modules/my-driver-module)

find_package(Zephyr REQUIRED)
project(my_zephyr_app)

target_sources(app PRIVATE src/main.cpp)
```

## Kconfig
```
menuconfig LED_SUBSYSTEM
    bool "LED Subsystem"
    default y

if LED_SUBSYSTEM

choice
    prompt "LED blink sleep time"
    default BLINK_SLEEP_1000MS
config BLINK_SLEEP_250MS
    bool "250ms (fast)"
config BLINK_SLEEP_500MS
    bool "500ms (medium-fast)"
config BLINK_SLEEP_1000MS
    bool "1s (medium)"
config BLINK_SLEEP_2000MS
    bool "2s (slow)"
endchoice

menuconfig ADV_LED_SETTINGS
    bool "Advanced LED settings"
    default n

if ADV_LED_SETTINGS

config LED_BRIGHTNESS
    int "LED brightness (0-100)"
    range 0 100
    default 100
config LED_FADE_DURATION
    int "LED fade duration (ms)"
    range 0 5000
    default 500

menu "Expert settings"
    visible if ADV_LED_SETTINGS
config LED_DEBUG
    bool "Enable LED debugging"
    default n
config CUSTOM_BLINK_PATTERN
    bool "Custom blink pattern"
    default n
endmenu

endif # ADV_LED_SETTINGS

endif # LED_SUBSYSTEM

config APP_HEARTBEAT_PERIOD_MS
    int "app-led heartbeat period (ms)"
    range 100 2000
    default 500

config BLINK_SPEED_TIME_MSEC
    int # <-- No prompt = hidden!
    default 250 if BLINK_SLEEP_250MS
    default 500 if BLINK_SLEEP_500MS
    default 1000 if BLINK_SLEEP_1000MS
    default 2000 if BLINK_SLEEP_2000MS
    default 0

source "Kconfig.zephyr"
```

## prj.conf
```kconfig
CONFIG_GPIO=y

# Logging ---------------------------------------------------------------------
CONFIG_LOG=y
#CONFIG_LOG_MODE_DEFERRED=y
## Wake up the logger thread more frequently (default is often 1000ms)
CONFIG_LOG_PROCESS_THREAD_SLEEP_MS=100

CONFIG_SENSOR=y  # my driver depends on sensor

# Shell -----------------------------------------------------------------------
CONFIG_SHELL=y
CONFIG_SHELL_TAB=y
CONFIG_SHELL_TAB_AUTOCOMPLETION=y
```

## app.overlay
```dts
/ {
	my_driver0: my_driver {
		compatible = "my,driver";
		led = <&green_led>;
		status = "okay";
	};
};
```

## src/main.cpp
```c
#include <zephyr/drivers/gpio.h>
#include <zephyr/kernel.h>
#include <zephyr/logging/log.h>
#include <zephyr/drivers/sensor.h>
#include <my_driver/my_driver.h>

#define USE_MY_DRIVER

#ifndef USE_MY_DRIVER
    /* now using alias created in app.overlay */
    #define LED_NODE DT_ALIAS(led2)

    static const struct gpio_dt_spec led = GPIO_DT_SPEC_GET(LED_NODE, gpios);
#else
    static const struct device *dev = DEVICE_DT_GET_ANY(my_driver);
#endif

LOG_MODULE_REGISTER(main, LOG_LEVEL_INF);

int main(void)
{
#ifndef USE_MY_DRIVER
    bool led_state = true;

    if (!gpio_is_ready_dt(&led)) return 0;

    if (gpio_pin_configure_dt(&led, GPIO_OUTPUT_ACTIVE) < 0) return 0;

    LOG_INF("led0 heartbeat %d msec.", CONFIG_APP_HEARTBEAT_PERIOD_MS);

    while (1) {
        if (gpio_pin_toggle_dt(&led) < 0) return 0;

        led_state = !led_state;
        LOG_INF("LED state: %s", led_state ? "ON" : "OFF");
        k_msleep(CONFIG_APP_HEARTBEAT_PERIOD_MS);  // second requirement from module 4 assignment
    }
#else
    if (!device_is_ready(dev)) {
        LOG_ERR("my_driver device not ready");
        return 0;
    }

    // LOG_INF("my_driver LED heartbeat %d msec.", CONFIG_APP_HEARTBEAT_PERIOD_MS);

    my_driver_set_led_on_ctr(dev, 0);

    /* LED is driven from the shell ("sensor fetch/read"); main just blocks */
    while (1) {
        k_sleep(K_FOREVER);     // block forever, other threads keep running
    }
#endif
    return 0;
}
```
